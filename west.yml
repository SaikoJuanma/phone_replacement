## west.yml
```yaml
manifest:
  remotes:
    - name: zephyrproject-rtos
      url-base: https://github.com/zephyrproject-rtos
  
  projects:
    - name: zephyr
      remote: zephyrproject-rtos
      revision: v4.2.0  
      path: deps/zephyr
      import:
        path-prefix: deps
  
  self:
    path: timer-alarm
```

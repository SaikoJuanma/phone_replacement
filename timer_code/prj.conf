## CMakeLists.txt
```
# Find Zephyr. This also loads Zephyr's build system.
cmake_minimum_required(VERSION 3.26.3)
if(NOT DEFINED BOARD)
  set(BOARD oxycontroller4_samd21)
endif()
find_package(Zephyr REQUIRED HINTS $ENV{ZEPHYR_BASE})
project(my_zephyr_app)

# Show the info about our project
message("Project: ${PROJECT_NAME}")
message("Board: ${BOARD}")


zephyr_compile_options(-U_FORTIFY_SOURCE)

target_sources(app PRIVATE
    src/main.c)
```

## prj.conf
```kconfig
CONFIG_USB_DEVICE_STACK=y
CONFIG_USB_CDC_ACM=y
CONFIG_SERIAL=y
CONFIG_CONSOLE=y
CONFIG_UART_CONSOLE=y
CONFIG_LOG=y
CONFIG_USB_CDC_ACM_LOG_LEVEL_OFF=y
```

## boards/adafruit_feather_m0_lora.overlay
```dts
/ {
	chosen {
		zephyr,console = &cdc_acm_uart0;
	};
};

zephyr_udc0: &usb0 {
    status = "okay";
};

&zephyr_udc0 {
	cdc_acm_uart0: cdc_acm_uart0 {
		compatible = "zephyr,cdc-acm-uart";
	};
};
```

## src/main.c
```c
#include <zephyr/kernel.h>
#include <zephyr/device.h>
#include <zephyr/drivers/gpio.h>
#include <zephyr/usb/usb_device.h>

const struct device *dev = DEVICE_DT_GET(DT_CHOSEN(zephyr_console));

int main(void)
{
    if (!device_is_ready(dev)) {
        printk("Device not ready\n");
        return -1;
    }

    // INFO: only necessary with adafruit
    if (usb_enable(NULL)) {
        printk("USB enable failed\n");
        return -1;
    }

    printk("This is the encoder sample code!\n");
    while (1) {
        k_sleep(K_SECONDS(3));
        printk("This is the encoder sample code!\n");
    }
}
```
